/*
 * EdgeForge Gesture Demo
 * Arduino Nano 33 BLE Sense (nRF52840)
 *
 * Reads LSM9DS1 accelerometer at 50 Hz.
 * Classifies gesture every 1 second: idle / shake / tap.
 *
 * Libraries required:
 *   1. TFLite Micro -- git clone into Arduino libraries folder:
 *      cd "C:\Users\YOUR_NAME\Documents\Arduino\libraries"
 *      git clone https://github.com/tensorflow/tflite-micro-arduino-examples Arduino_TensorFlowLite
 *
 *   2. IMU -- Tools -> Manage Libraries -> search "Arduino_LSM9DS1" -> Install
 *
 * Required file in this sketch folder:
 *   model_data.h  (generated by: edgeforge compile ... --target=arduino)
 *
 * Serial: 115200 baud
 */

#include <Arduino_LSM9DS1.h>

// TFLite Micro umbrella header -- must be first, sets up all include paths
#include <TensorFlowLite.h>
#include <tensorflow/lite/micro/micro_interpreter.h>
#include <tensorflow/lite/micro/micro_mutable_op_resolver.h>
#include <tensorflow/lite/schema/schema_generated.h>

// EdgeForge generated model flatbuffer
#include "model_data.h"

// ── Configuration ─────────────────────────────────────────────────────────────
#define SAMPLE_RATE_HZ   50
#define WINDOW_SAMPLES   50
#define N_AXES           3
#define N_CLASSES        3
#define ARENA_SIZE       (24 * 1024)

const char *CLASS_NAMES[] = { "idle", "shake", "tap" };

// ── TFLite Micro ──────────────────────────────────────────────────────────────
static tflite::MicroMutableOpResolver<12> resolver;
static uint8_t tensor_arena[ARENA_SIZE];
static const tflite::Model      *tfl_model    = nullptr;
static tflite::MicroInterpreter *interpreter  = nullptr;
static TfLiteTensor             *input_tensor  = nullptr;
static TfLiteTensor             *output_tensor = nullptr;

// ── Sensor window ─────────────────────────────────────────────────────────────
static float         g_window[WINDOW_SAMPLES][N_AXES];
static int           g_window_idx  = 0;
static bool          g_window_full = false;
static unsigned long g_last_sample_ms = 0;

// ── Setup ─────────────────────────────────────────────────────────────────────
void setup() {
    Serial.begin(115200);
    while (!Serial && millis() < 3000);

    Serial.println();
    Serial.println("========================================");
    Serial.println(" EdgeForge Gesture Demo");
    Serial.println(" Arduino Nano 33 BLE Sense (nRF52840)");
    Serial.println("========================================");

    // IMU
    if (!IMU.begin()) {
        Serial.println("[FAIL] LSM9DS1 init failed");
        while (1);
    }
    Serial.print("[OK]  LSM9DS1 ready (");
    Serial.print(IMU.accelerationSampleRate());
    Serial.println(" Hz)");

    // Register all ops used by the gesture model
    resolver.AddConv2D();
    resolver.AddDepthwiseConv2D();
    resolver.AddFullyConnected();
    resolver.AddReshape();
    resolver.AddAveragePool2D();
    resolver.AddMean();          // GlobalAveragePool maps to MEAN in TFLite
    resolver.AddSoftmax();
    resolver.AddRelu();
    resolver.AddQuantize();
    resolver.AddDequantize();
    resolver.AddPad();
    resolver.AddAdd();

    // Load model
    tfl_model = tflite::GetModel(model_data);
    if (tfl_model->version() != TFLITE_SCHEMA_VERSION) {
        Serial.println("[FAIL] Schema version mismatch");
        while (1);
    }

    interpreter = new tflite::MicroInterpreter(
        tfl_model, resolver, tensor_arena, ARENA_SIZE
    );

    if (interpreter->AllocateTensors() != kTfLiteOk) {
        Serial.println("[FAIL] AllocateTensors -- increase ARENA_SIZE");
        while (1);
    }

    input_tensor  = interpreter->input(0);
    output_tensor = interpreter->output(0);

    Serial.print("[OK]  Model loaded, arena used: ");
    Serial.print(interpreter->arena_used_bytes());
    Serial.println(" bytes");
    Serial.println("----------------------------------------");
    Serial.println(" idle=still  shake=move fast  tap=knock");
    Serial.println("----------------------------------------");
    Serial.println();

    g_last_sample_ms = millis();
}

// ── Loop ──────────────────────────────────────────────────────────────────────
void loop() {
    unsigned long now = millis();
    if ((now - g_last_sample_ms) < (1000 / SAMPLE_RATE_HZ)) return;
    g_last_sample_ms = now;

    float ax, ay, az;
    if (IMU.accelerationAvailable()) {
        IMU.readAcceleration(ax, ay, az);
        g_window[g_window_idx][0] = ax;
        g_window[g_window_idx][1] = ay;
        g_window[g_window_idx][2] = az;
        g_window_idx = (g_window_idx + 1) % WINDOW_SAMPLES;
        if (g_window_idx == 0) g_window_full = true;
    }

    if (g_window_full && g_window_idx == 0) {
        run_inference();
    }
}

// ── Inference ─────────────────────────────────────────────────────────────────
void run_inference() {
    float *inp = input_tensor->data.f;
    for (int i = 0; i < WINDOW_SAMPLES; i++) {
        int idx = (g_window_idx + i) % WINDOW_SAMPLES;
        inp[i * N_AXES + 0] = g_window[idx][0];
        inp[i * N_AXES + 1] = g_window[idx][1];
        inp[i * N_AXES + 2] = g_window[idx][2];
    }

    unsigned long t0 = micros();
    if (interpreter->Invoke() != kTfLiteOk) {
        Serial.println("[WARN] Invoke failed");
        return;
    }
    unsigned long elapsed_ms = (micros() - t0) / 1000;

    float *out  = output_tensor->data.f;
    int    best = 0;
    float  bscore = out[0];
    for (int i = 1; i < N_CLASSES; i++) {
        if (out[i] > bscore) { bscore = out[i]; best = i; }
    }

    Serial.print("[INFER] ");
    Serial.print(CLASS_NAMES[best]);
    Serial.print("  (");
    for (int i = 0; i < N_CLASSES; i++) {
        Serial.print(CLASS_NAMES[i]);
        Serial.print("=");
        Serial.print(out[i], 2);
        if (i < N_CLASSES - 1) Serial.print("  ");
    }
    Serial.print(")  ");
    Serial.print(elapsed_ms);
    Serial.println(" ms");
}
